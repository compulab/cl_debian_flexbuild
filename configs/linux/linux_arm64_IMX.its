## configs/linux/linux_arm64_IMX.its
```
/*
 * Copyright 2018-2023 NXP
 *
 * Shengzhou Liu <Shengzhou.Liu@nxp.com>
 *
 */


/dts-v1/;

/ {
	description = "generate itb image for i.MX ARM 64bit Linux Kernel";
	#address-cells = <1>;

	images {
		kernel {
			description = "ARM64 Linux kernel";
			data = /incbin/("../../build/linux/kernel/arm64/IMX/Image.gz");
			type = "kernel";
			arch = "arm64";
			os = "linux";
			compression = "gzip";
			load = <0x80280000>;
			entry = <0x80280000>;
		};

		initrd {
			description = "initrd for arm64";
			data = /incbin/("../../build/images/rootfs_poky_tiny_arm64.cpio.gz");
			type = "ramdisk";
			arch = "arm64";
			os = "linux";
			load = <0x00000000>;
			entry = <0x00000000>;
		};

		ucm-imx8m-plus-sbev-dtb {
			description = "Flattened Device Tree blob";
			data = /incbin/("../../build/linux/kernel/arm64/IMX/ucm-imx8m-plus-sbev.dtb");
			type = "flat_dt";
			arch = "arm64";
			os = "linux";
			compression = "none";
			load = <0x90000000>;
		};

		ucm-imx8m-plus-dtb {
			description = "Flattened Device Tree blob";
			data = /incbin/("../../build/linux/kernel/arm64/IMX/ucm-imx8m-plus.dtb");
			type = "flat_dt";
			arch = "arm64";
			os = "linux";
			compression = "none";
			load = <0x90000000>;
		};

		mcm-imx8m-plus-dtb {
			description = "Flattened Device Tree blob";
			data = /incbin/("../../build/linux/kernel/arm64/IMX/mcm-imx8m-plus.dtb");
			type = "flat_dt";
			arch = "arm64";
			os = "linux";
			compression = "none";
			load = <0x90000000>;
		};

		som-imx8m-plus-dtb {
			description = "Flattened Device Tree blob";
			data = /incbin/("../../build/linux/kernel/arm64/IMX/som-imx8m-plus.dtb");
			type = "flat_dt";
			arch = "arm64";
			os = "linux";
			compression = "none";
			load = <0x90000000>;
		};

		iot-gate-imx8plus-dtb {
			description = "Flattened Device Tree blob";
			data = /incbin/("../../build/linux/kernel/arm64/IMX/iot-gate-imx8plus.dtb");
			type = "flat_dt";
			arch = "arm64";
			os = "linux";
			compression = "none";
			load = <0x90000000>;
		};

		iotdin-imx8p-dtb {
			description = "Flattened Device Tree blob";
			data = /incbin/("../../build/linux/kernel/arm64/IMX/iotdin-imx8p.dtb");
			type = "flat_dt";
			arch = "arm64";
			os = "linux";
			compression = "none";
			load = <0x90000000>;
		};
	};

	configurations {
		ucm-imx8m-plus-sbev {
			description = "Boot Linux kernel";
			kernel = "kernel";
			fdt = "ucm-imx8m-plus-sbev-dtb";
			ramdisk = "initrd";
		};
		ucm-imx8m-plus {
			description = "boot linux kernel";
			kernel = "kernel";
			fdt = "ucm-imx8m-plus-dtb";
			ramdisk = "initrd";
		};
		mcm-imx8m-plus {
			description = "boot linux kernel";
			kernel = "kernel";
			fdt = "mcm-imx8m-plus-dtb";
			ramdisk = "initrd";
		};
		som-imx8m-plus {
			description = "boot linux kernel";
			kernel = "kernel";
			fdt = "som-imx8m-plus-dtb";
			ramdisk = "initrd";
		};
		iot-gate-imx8plus {
			description = "boot linux kernel";
			kernel = "kernel";
			fdt = "iot-gate-imx8plus-dtb";
			ramdisk = "initrd";
		};
		iotdin-imx8p {
			description = "boot linux kernel";
			kernel = "kernel";
			fdt = "iotdin-imx8p-dtb";
			ramdisk = "initrd";
		};
	};
};
```
